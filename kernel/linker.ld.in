#define KERNEL_OFFSET 0xffffffff80000000

OUTPUT_FORMAT("elf64-x86-64")

ENTRY(_start32)

SECTIONS
{
    . = KERNEL_OFFSET + 0x100000;

    .multiboot_header : AT(ADDR(.multiboot_header) - KERNEL_OFFSET){
        KEEP(*(.multiboot_header))
    }

    .text : AT(ADDR(.text) - KERNEL_OFFSET) {
        *(.text)
    }

    .rodata ALIGN(4K) : AT(ADDR(.rodata) - KERNEL_OFFSET) {
        *(.rodata)
    }

    .data ALIGN(4k) : AT(ADDR(.data) - KERNEL_OFFSET) {
        *(.boot_gdt)
        *(.data)
    }

    .bss ALIGN(4K) : AT(ADDR(.bss) - KERNEL_OFFSET) {
        *(.bss)
    }

    /DISCARD/ : {
        *(.note*)
        *(.comment*)
    }
}
